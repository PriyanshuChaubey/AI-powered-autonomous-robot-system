/*
 * robot_controller.ino
 * Obstacle-avoiding two-wheel robot for ESP32-WROOM-32.
 *
 * GENERATED by the project's firmware pipeline (Agent 3). Do not hand-edit:
 * change the architecture JSON and regenerate, so the pin map and the code
 * stay in sync.
 *
 * Wiring is fixed by architecture.json. Every pin below is validated against it.
 */

#include <Arduino.h>

// ---------------------------------------------------------------- pin map
#define MOTOR_A_ENA      25
#define MOTOR_A_IN1      26
#define MOTOR_A_IN2      27
#define MOTOR_B_ENB      14
#define MOTOR_B_IN3      32
#define MOTOR_B_IN4      33

#define SONAR_TRIG       18
#define SONAR_ECHO       19

#define IR_LEFT          34
#define IR_RIGHT         35

#define SERVO_SCAN       13
#define LED_STATUS        2

// -------------------------------------------------------------- constants
static const int   STOP_DISTANCE_CM   = 20;
static const int   CLEAR_DISTANCE_CM  = 30;
static const int   CRUISE_DUTY        = 180;
static const int   TURN_DUTY          = 200;
static const int   PWM_FREQ           = 1000;
static const int   PWM_BITS           = 8;
static const unsigned long LOOP_MS    = 20;    // 50 Hz
static const unsigned long SONAR_MS   = 60;    // sensor settling
static const unsigned long TURN_MS    = 450;
static const unsigned long ECHO_TIMEOUT_US = 25000UL;  // ~4 m round trip

// ------------------------------------------------------- PWM compatibility
// Arduino-ESP32 core 2.x and 3.x use different LEDC APIs. This shim keeps the
// sketch compiling on both (NFR-4).
#if defined(ESP_ARDUINO_VERSION_MAJOR) && ESP_ARDUINO_VERSION_MAJOR >= 3
  #define PWM_SETUP(pin, ch)            ledcAttach((pin), PWM_FREQ, PWM_BITS)
  #define PWM_WRITE(pin, ch, duty)      ledcWrite((pin), (duty))
#else
  #define PWM_SETUP(pin, ch)            do { ledcSetup((ch), PWM_FREQ, PWM_BITS); ledcAttachPin((pin), (ch)); } while (0)
  #define PWM_WRITE(pin, ch, duty)      ledcWrite((ch), (duty))
#endif

static const int CH_A = 0;
static const int CH_B = 1;

// ------------------------------------------------------------------ state
enum RobotState { FORWARD, STOPPED, TURNING };
static RobotState state = FORWARD;

static unsigned long lastLoopMs    = 0;
static unsigned long lastSonarMs   = 0;
static unsigned long stateSinceMs  = 0;
static int  distanceCm  = -1;          // -1 = no reading yet
static bool leftBlocked  = false;
static bool rightBlocked = false;
static bool ledOn = false;

// ------------------------------------------------------------------ motors
static void motorsStop() {
  digitalWrite(MOTOR_A_IN1, LOW);
  digitalWrite(MOTOR_A_IN2, LOW);
  digitalWrite(MOTOR_B_IN3, LOW);
  digitalWrite(MOTOR_B_IN4, LOW);
  PWM_WRITE(MOTOR_A_ENA, CH_A, 0);
  PWM_WRITE(MOTOR_B_ENB, CH_B, 0);
}

static void motorsForward(int duty) {
  digitalWrite(MOTOR_A_IN1, HIGH);
  digitalWrite(MOTOR_A_IN2, LOW);
  digitalWrite(MOTOR_B_IN3, HIGH);
  digitalWrite(MOTOR_B_IN4, LOW);
  PWM_WRITE(MOTOR_A_ENA, CH_A, duty);
  PWM_WRITE(MOTOR_B_ENB, CH_B, duty);
}

static void motorsTurnRight(int duty) {
  // left wheel back, right wheel forward -> pivot turn
  digitalWrite(MOTOR_A_IN1, LOW);
  digitalWrite(MOTOR_A_IN2, HIGH);
  digitalWrite(MOTOR_B_IN3, HIGH);
  digitalWrite(MOTOR_B_IN4, LOW);
  PWM_WRITE(MOTOR_A_ENA, CH_A, duty);
  PWM_WRITE(MOTOR_B_ENB, CH_B, duty);
}

// ------------------------------------------------------------------- sonar
// Fully non-blocking HC-SR04 driver. The ping is started on one cycle and the
// echo is sampled on later cycles, so loop() never stalls (NFR-1). A timeout
// or a zero reading is treated as an obstacle (fail safe).
enum SonarPhase { SONAR_IDLE, SONAR_WAIT_RISE, SONAR_WAIT_FALL };
static SonarPhase sonarPhase = SONAR_IDLE;
static unsigned long sonarEdgeUs = 0;

static void sonarPing() {
  digitalWrite(SONAR_TRIG, LOW);
  delayMicroseconds(2);
  digitalWrite(SONAR_TRIG, HIGH);
  delayMicroseconds(10);
  digitalWrite(SONAR_TRIG, LOW);
  sonarEdgeUs = micros();
  sonarPhase = SONAR_WAIT_RISE;
}

static void sonarStep() {
  switch (sonarPhase) {
    case SONAR_IDLE:
      break;

    case SONAR_WAIT_RISE:
      if (digitalRead(SONAR_ECHO) == HIGH) {
        sonarEdgeUs = micros();
        sonarPhase = SONAR_WAIT_FALL;
      } else if (micros() - sonarEdgeUs > ECHO_TIMEOUT_US) {
        distanceCm = 0;                  // no echo: fail safe
        sonarPhase = SONAR_IDLE;
      }
      break;

    case SONAR_WAIT_FALL:
      if (digitalRead(SONAR_ECHO) == LOW) {
        unsigned long width = micros() - sonarEdgeUs;
        distanceCm = (int)(width / 58UL);  // us -> cm
        sonarPhase = SONAR_IDLE;
      } else if (micros() - sonarEdgeUs > ECHO_TIMEOUT_US) {
        distanceCm = 0;                  // echo never ended: fail safe
        sonarPhase = SONAR_IDLE;
      }
      break;
  }
}

// --------------------------------------------------------------- telemetry
static void telemetry() {
  Serial.print("{\"state\":\"");
  Serial.print(state == FORWARD ? "FORWARD" : state == STOPPED ? "STOPPED" : "TURNING");
  Serial.print("\",\"distance_cm\":");
  Serial.print(distanceCm);
  Serial.print(",\"ir_left\":");
  Serial.print(leftBlocked ? 1 : 0);
  Serial.print(",\"ir_right\":");
  Serial.print(rightBlocked ? 1 : 0);
  Serial.println("}");
}

// ------------------------------------------------------------------ status
static void statusService(unsigned long now) {
  bool want = (state == FORWARD) ? ((now / 250) % 2 == 0) : true;
  if (want != ledOn) {
    ledOn = want;
    digitalWrite(LED_STATUS, ledOn ? HIGH : LOW);
  }
}

// -------------------------------------------------------------------- setup
void setup() {
  Serial.begin(115200);

  pinMode(MOTOR_A_IN1, OUTPUT);
  pinMode(MOTOR_A_IN2, OUTPUT);
  pinMode(MOTOR_B_IN3, OUTPUT);
  pinMode(MOTOR_B_IN4, OUTPUT);
  PWM_SETUP(MOTOR_A_ENA, CH_A);
  PWM_SETUP(MOTOR_B_ENB, CH_B);

  pinMode(SONAR_TRIG, OUTPUT);
  pinMode(SONAR_ECHO, INPUT);

  pinMode(IR_LEFT, INPUT);
  pinMode(IR_RIGHT, INPUT);

  pinMode(LED_STATUS, OUTPUT);

  motorsStop();               // never energise the motors before this
  state = FORWARD;
  stateSinceMs = millis();
}

// --------------------------------------------------------------------- loop
void loop() {
  unsigned long now = millis();
  if (now - lastLoopMs < LOOP_MS) return;
  lastLoopMs = now;

  // ---- sensors
  sonarStep();                        // advance the echo measurement every cycle
  if (sonarPhase == SONAR_IDLE && now - lastSonarMs >= SONAR_MS) {
    lastSonarMs = now;
    sonarPing();                      // sensor has settled, start the next ping
  }
  leftBlocked  = (digitalRead(IR_LEFT)  == LOW);
  rightBlocked = (digitalRead(IR_RIGHT) == LOW);

  // ---- state machine
  switch (state) {
    case FORWARD:
      if (distanceCm >= 0 && distanceCm < STOP_DISTANCE_CM) {
        motorsStop();
        state = STOPPED;
        stateSinceMs = now;
      } else if (leftBlocked && !rightBlocked) {
        motorsTurnRight(TURN_DUTY);
        state = TURNING;
        stateSinceMs = now;
      } else {
        motorsForward(CRUISE_DUTY);
      }
      break;

    case STOPPED:
      if (now - stateSinceMs >= TURN_MS) {
        motorsTurnRight(TURN_DUTY);
        state = TURNING;
        stateSinceMs = now;
      }
      break;

    case TURNING:
      if (now - stateSinceMs >= TURN_MS) {
        if (distanceCm >= CLEAR_DISTANCE_CM) {
          motorsForward(CRUISE_DUTY);
          state = FORWARD;
        } else {
          motorsStop();
          state = STOPPED;
        }
        stateSinceMs = now;
      }
      break;
  }

  telemetry();
  statusService(now);
}

/*
 * robot_controller.ino
 * Arduino Uno R3 - autonomous obstacle-avoidance robot.
 *
 * Controller: Arduino Uno R3 / ATmega328P
 * Motor driver: L298N
 * Distance sensor: HC-SR04
 * Sensor positioning: MG995 servo
 *
 * Generated by the multi-agent firmware pipeline.
 */

#include <Arduino.h>
#include <Servo.h>

// --------------------------------------------------------------- pin map

#define MOTOR_A_ENA 5
#define MOTOR_A_IN1 7
#define MOTOR_A_IN2 8

#define MOTOR_B_ENB 6
#define MOTOR_B_IN3 9
#define MOTOR_B_IN4 10

#define SONAR_TRIG 11
#define SONAR_ECHO 12

#define SERVO_SCAN 13

// -------------------------------------------------------------- constants

static const unsigned long LOOP_INTERVAL_MS = 20;
static const unsigned long SONAR_INTERVAL_MS = 60;
static const unsigned long ECHO_TIMEOUT_US = 25000UL;
static const unsigned long COMMAND_TIMEOUT_MS = 1000;

static const int STOP_DISTANCE_CM = 20;
static const int CRUISE_SPEED = 150;
static const int TURN_SPEED = 150;

static const int SERVO_CENTER_DEG = 90;
static const int SERVO_LEFT_DEG = 150;
static const int SERVO_RIGHT_DEG = 30;

// ----------------------------------------------------------------- objects

Servo scanServo;

// ------------------------------------------------------------------ state

enum RobotState {
    STOPPED,
    FORWARD,
    TURNING,
    OBSTACLE
};

static RobotState robotState = STOPPED;

static unsigned long lastLoopMs = 0;
static unsigned long lastSonarMs = 0;
static unsigned long lastCommandMs = 0;
static unsigned long stateSinceMs = 0;

static int distanceCm = -1;
static bool sensorFault = true;

// --------------------------------------------------------------- motors

static void motorsStop() {
    analogWrite(MOTOR_A_ENA, 0);
    analogWrite(MOTOR_B_ENB, 0);

    digitalWrite(MOTOR_A_IN1, LOW);
    digitalWrite(MOTOR_A_IN2, LOW);
    digitalWrite(MOTOR_B_IN3, LOW);
    digitalWrite(MOTOR_B_IN4, LOW);
}

static void motorsForward(int speedValue) {
    digitalWrite(MOTOR_A_IN1, HIGH);
    digitalWrite(MOTOR_A_IN2, LOW);

    digitalWrite(MOTOR_B_IN3, HIGH);
    digitalWrite(MOTOR_B_IN4, LOW);

    analogWrite(MOTOR_A_ENA, constrain(speedValue, 0, 255));
    analogWrite(MOTOR_B_ENB, constrain(speedValue, 0, 255));
}

static void motorsTurnRight(int speedValue) {
    digitalWrite(MOTOR_A_IN1, LOW);
    digitalWrite(MOTOR_A_IN2, HIGH);

    digitalWrite(MOTOR_B_IN3, HIGH);
    digitalWrite(MOTOR_B_IN4, LOW);

    analogWrite(MOTOR_A_ENA, constrain(speedValue, 0, 255));
    analogWrite(MOTOR_B_ENB, constrain(speedValue, 0, 255));
}

// -------------------------------------------------------------- ultrasonic

enum SonarPhase {
    SONAR_IDLE,
    SONAR_WAIT_RISE,
    SONAR_WAIT_FALL
};

static SonarPhase sonarPhase = SONAR_IDLE;
static unsigned long echoStartUs = 0;

static void startSonarMeasurement() {
    digitalWrite(SONAR_TRIG, LOW);
    delayMicroseconds(2);

    digitalWrite(SONAR_TRIG, HIGH);
    delayMicroseconds(10);

    digitalWrite(SONAR_TRIG, LOW);

    echoStartUs = micros();
    sonarPhase = SONAR_WAIT_RISE;
}

static void updateSonar() {
    unsigned long nowUs = micros();

    if (sonarPhase == SONAR_WAIT_RISE) {
        if (digitalRead(SONAR_ECHO) == HIGH) {
            echoStartUs = nowUs;
            sonarPhase = SONAR_WAIT_FALL;
        } else if (nowUs - echoStartUs > ECHO_TIMEOUT_US) {
            distanceCm = 0;
            sensorFault = true;
            sonarPhase = SONAR_IDLE;
        }
    }
    else if (sonarPhase == SONAR_WAIT_FALL) {
        if (digitalRead(SONAR_ECHO) == LOW) {
            unsigned long pulseWidth = nowUs - echoStartUs;
            distanceCm = (int)(pulseWidth / 58UL);
            sensorFault = (distanceCm <= 0);
            sonarPhase = SONAR_IDLE;
        } else if (nowUs - echoStartUs > ECHO_TIMEOUT_US) {
            distanceCm = 0;
            sensorFault = true;
            sonarPhase = SONAR_IDLE;
        }
    }
}

// -------------------------------------------------------------- serial I/O

static void processSerialCommands() {
    while (Serial.available() > 0) {
        char command = (char)Serial.read();
        lastCommandMs = millis();

        if (command == 'F') {
            if (!sensorFault && distanceCm >= STOP_DISTANCE_CM) {
                robotState = FORWARD;
                motorsForward(CRUISE_SPEED);
            } else {
                robotState = OBSTACLE;
                motorsStop();
            }
        }
        else if (command == 'R') {
            robotState = TURNING;
            motorsTurnRight(TURN_SPEED);
            stateSinceMs = millis();
        }
        else if (command == 'S') {
            robotState = STOPPED;
            motorsStop();
        }
        else if (command == 'C') {
            scanServo.write(SERVO_CENTER_DEG);
        }
        else if (command == 'L') {
            scanServo.write(SERVO_LEFT_DEG);
        }
        else if (command == 'Q') {
            scanServo.write(SERVO_RIGHT_DEG);
        }
        else {
            robotState = STOPPED;
            motorsStop();
        }
    }
}

static void sendTelemetry() {
    Serial.print("{\"state\":");

    switch (robotState) {
        case STOPPED:
            Serial.print("\"STOPPED\"");
            break;
        case FORWARD:
            Serial.print("\"FORWARD\"");
            break;
        case TURNING:
            Serial.print("\"TURNING\"");
            break;
        case OBSTACLE:
            Serial.print("\"OBSTACLE\"");
            break;
    }

    Serial.print(",\"distance_cm\":");
    Serial.print(distanceCm);

    Serial.print(",\"sensor_fault\":");
    Serial.print(sensorFault ? "true" : "false");

    Serial.println("}");
}

// ------------------------------------------------------------------- setup

void setup() {
    Serial.begin(115200);

    pinMode(MOTOR_A_ENA, OUTPUT);
    pinMode(MOTOR_A_IN1, OUTPUT);
    pinMode(MOTOR_A_IN2, OUTPUT);

    pinMode(MOTOR_B_ENB, OUTPUT);
    pinMode(MOTOR_B_IN3, OUTPUT);
    pinMode(MOTOR_B_IN4, OUTPUT);

    pinMode(SONAR_TRIG, OUTPUT);
    pinMode(SONAR_ECHO, INPUT);

    motorsStop();

    scanServo.attach(SERVO_SCAN);
    scanServo.write(SERVO_CENTER_DEG);

    lastCommandMs = millis();
    lastSonarMs = millis();
    lastLoopMs = millis();

    robotState = STOPPED;
}

// -------------------------------------------------------------------- loop

void loop() {
    unsigned long now = millis();

    if (now - lastLoopMs < LOOP_INTERVAL_MS) {
        return;
    }

    lastLoopMs = now;

    updateSonar();

    if (sonarPhase == SONAR_IDLE &&
        now - lastSonarMs >= SONAR_INTERVAL_MS) {
        lastSonarMs = now;
        startSonarMeasurement();
    }

    processSerialCommands();

    // Fail-safe: invalid sensor readings stop the robot.
    if (sensorFault &&
        (robotState == FORWARD || robotState == TURNING)) {
        robotState = OBSTACLE;
        motorsStop();
    }

    // Stop when an obstacle is too close.
    if (distanceCm >= 0 &&
        distanceCm < STOP_DISTANCE_CM &&
        robotState == FORWARD) {
        robotState = OBSTACLE;
        motorsStop();
    }

    // Stop if computer commands are no longer received.
    if (robotState != STOPPED &&
        now - lastCommandMs > COMMAND_TIMEOUT_MS) {
        robotState = STOPPED;
        motorsStop();
    }

    sendTelemetry();
}
